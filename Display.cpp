// base class GxEPD2_GFX can be used to pass references or pointers to the display instance as parameter, uses ~1.2k more lines of code
// enable or disable GxEPD2_GFX base class
#define ENABLE_GxEPD2_GFX 0

#include <Arduino.h>
#include "Display.h"
#include <SPI.h>
#include <GxEPD2_BW.h>
#include <GxEPD2_3C.h>
#include <Fonts/FreeSansBold9pt7b.h>

namespace Display {
  // <===================>
  //   Logo Bitmap Data
  // <===================>
  static const unsigned char logoBitmapData[] PROGMEM = {
    0x00, 0x00, 0x00, 0x00, 0x00, 0x00, 0x00, 0x00, 0x00, 0x00, 0x00, 0x00, 
    0x00, 0x00, 0x00, 0x00, 0x00, 0x00, 0x00, 0x00, 0x00, 0x00, 0x00, 0x00, 
    0x00, 0x00, 0x00, 0x00, 0x00, 0x00, 0x00, 0x00, 0x00, 0x00, 0x00, 0x00, 
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    0x00, 0x00, 0x00, 0x00, 0x00, 0x00, 0x00, 0x00
  };

  // <===================>
  //   SPI bus (ESP32-S3)
  // <===================>
  static SPIClass epdSPI(FSPI);

  // <===================>
  //   E-Paper SPI pins
  // <===================>
  static constexpr int PIN_SCK  = 36;
  static constexpr int PIN_MOSI = 45;
  static constexpr int PIN_MISO = -1;

  // <===================>
  //   E-Paper SPI pins
  // <===================>
  static constexpr int PIN_CS   = 26;
  static constexpr int PIN_DC   = 48;
  static constexpr int PIN_RST  = 47;
  static constexpr int PIN_BUSY = 34;

  // <===================>
  //   3.7'' EPD Module
  // <===================>
  static GxEPD2_BW<GxEPD2_370_GDEY037T03, GxEPD2_370_GDEY037T03::HEIGHT> display(GxEPD2_370_GDEY037T03(PIN_CS, PIN_DC, PIN_RST, PIN_BUSY));


  void init()
  {
    display.init(115200, true, 50, false);

    pinMode(PIN_BUSY, INPUT);
    pinMode(PIN_RST, OUTPUT);
    
    epdSPI.begin(PIN_SCK, PIN_MISO, PIN_MOSI, PIN_CS);

    // Bind SPI to display (recommended on ESP32-S3)
    display.epd2.selectSPI(
      epdSPI,
      SPISettings(4000000, MSBFIRST, SPI_MODE0)
    );
    
    display.setRotation(1);
  }

  void drawActiveScreen() 
  {
    // 416x240
    display.setFont(&FreeSansBold9pt7b);
    display.setTextColor(GxEPD_BLACK);

    constexpr int OUTLINE_X = 6;
    constexpr int OUTLINE_Y = 6;
    constexpr int OUTLINE_W = 404;
    constexpr int OUTLINE_H = 228;

    constexpr int INNER_BOX_X = 12;
    constexpr int INNER_BOX_Y = 44;
    constexpr int INNER_BOX_W = 392;
    constexpr int INNER_BOX_H = 184;

    display.setFullWindow();
    display.firstPage();
    do
    {
      display.fillScreen(GxEPD_WHITE);
      display.drawRect(OUTLINE_X, OUTLINE_Y, OUTLINE_W, OUTLINE_H, GxEPD_BLACK);
      display.drawRect(INNER_BOX_X, INNER_BOX_Y, INNER_BOX_W, INNER_BOX_H, GxEPD_BLACK);
    }
    while (display.nextPage());
  }

  void drawSleepingScreen()
  {
    constexpr int OUTLINE_X = 6;
    constexpr int OUTLINE_Y = 6;
    constexpr int OUTLINE_W = 404;
    constexpr int OUTLINE_H = 228;

    display.setFullWindow();
    display.firstPage();
    do
    {
      display.fillScreen(GxEPD_WHITE);
      display.drawRect(OUTLINE_X, OUTLINE_Y, OUTLINE_W, OUTLINE_H, GxEPD_BLACK);
      display.drawXBitmap(108, 20, logoBitmapData, 200, 200, GxEPD_BLACK);
    }
    while (display.nextPage());
  }

  void updateBattery(int percentage, bool charging)
  {
    constexpr int BAT_X = 344;
    constexpr int BAT_Y = 12;
    constexpr int BAT_W = 60;
    constexpr int BAT_H = 26;

    display.setPartialWindow(BAT_X, BAT_Y, BAT_W, BAT_H);
    display.firstPage();
    do
    {
      display.fillRect(BAT_X, BAT_Y, BAT_W, BAT_H, GxEPD_WHITE);
      display.drawRect(BAT_X, BAT_Y, BAT_W, BAT_H, GxEPD_BLACK);

      display.setCursor(BAT_X + 5, BAT_Y + 18);
      if (charging)
      {
        display.print("CHRG");
      } 
      else
      {
        display.print(percentage);
        display.print("%");
      }
    }
    while (display.nextPage());
  }

  void updateInputBuffer(const char* keyBuffer)
  {
    constexpr int TB_X = 12;
    constexpr int TB_Y = 202;
    constexpr int TB_W = 392;
    constexpr int TB_H = 26;

    static unsigned long lastUpdate = 0;
    const unsigned long INTERVAL = 20;

    if (millis() - lastUpdate < INTERVAL) return;

    lastUpdate = millis();

    display.setPartialWindow(TB_X, TB_Y, TB_W, TB_H);
    display.firstPage();
    do
    {
      display.fillRect(TB_X, TB_Y, TB_W, TB_H, GxEPD_WHITE);
      display.drawRect(TB_X, TB_Y, TB_W, TB_H, GxEPD_BLACK);

      display.setCursor(TB_X + 5, TB_Y + 18);
      display.print(keyBuffer);
    }
    while (display.nextPage());

    // !!!!!!!!!!!!!!!!!!!!!!!!!!!!!!!!!!!!!ADD BLINK CURSOR EVENTUALLY!!!!!!!!!!!!!!!!!!!!!!!!!!!!!!!!!!!!!!!!!!!!!!!!!!!!!!!!
  }

  // void Display::updateInputBuffer(const char* buffer, size_t length)
  // {
  //     display.setCursor(0, 50);
  //     for (size_t i = 0; i < length; i++) {
  //         display.print(buffer[i]);
  //     }
  // }
}

// void updateBattery()
// {
//   if (millis() - lastBatteryRead >= BATTERY_INTERVAL) {
//     lastBatteryRead = millis();

//     float batteryVoltage = 0.0;
//     int batteryPercent = 0;

//     batteryVoltage = readBatteryVoltage();
//     batteryPercent = voltageToPercent(batteryVoltage);

//     display.setPartialWindow(BAT_X, BAT_Y, BAT_W, BAT_H);
//     display.firstPage();
//     do
//     {
//       display.fillRect(BAT_X, BAT_Y, BAT_W, BAT_H, GxEPD_WHITE);
//       display.drawRect(BAT_X, BAT_Y, BAT_W, BAT_H, GxEPD_BLACK);

//       display.setCursor(BAT_X + 5, BAT_Y + 18);
//       display.print(batteryPercent);
//       display.print("%");
//     }
//     while (display.nextPage());
//   }
// }

// oid updateDisplay()
// {
//   if (millis() - lastDisplayUpdate < DISPLAY_INTERVAL)
//     return;

//   lastDisplayUpdate = millis();

//   display.setPartialWindow(TB_X, TB_Y, TB_W, TB_H);
//   display.firstPage();
//   do
//   {
//     display.fillRect(TB_X, TB_Y, TB_W, TB_H, GxEPD_WHITE);
//     display.drawRect(TB_X, TB_Y, TB_W, TB_H, GxEPD_BLACK);

//     display.setCursor(TB_X + 5, TB_Y + 18);
//     display.print(keyBuffer);
//   }
//   while (display.nextPage());
// }