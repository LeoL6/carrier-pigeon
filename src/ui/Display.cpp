// base class GxEPD2_GFX can be used to pass references or pointers to the display instance as parameter, uses ~1.2k more lines of code
// enable or disable GxEPD2_GFX base class
#define ENABLE_GxEPD2_GFX 0

#include "Display.h"

#include <Arduino.h>
#include <SPI.h>
#include <GxEPD2_BW.h>
#include <GxEPD2_3C.h>
#include <Fonts/FreeSansBold9pt7b.h>
#include <Fonts/FreeSans9pt7b.h>

namespace Display 
{
  // <===================>
  //   Logo Bitmap Data
  // <===================>
  static const unsigned char logoBitmapData[] PROGMEM = 
  {
    0x00, 0x00, 0x00, 0x00, 0x00, 0x00, 0x00, 0x00, 0x00, 0x00, 0x00, 0x00, 
    0x00, 0x00, 0x00, 0x00, 0x00, 0x00, 0x00, 0x00, 0x00, 0x00, 0x00, 0x00, 
    0x00, 0x00, 0x00, 0x00, 0x00, 0x00, 0x00, 0x00, 0x00, 0x00, 0x00, 0x00, 
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    0x00, 0x00, 0x00, 0x00, 0x00, 0x00, 0x00, 0x00
  };

  // <===================>
  //   SPI bus (ESP32-S3)
  // <===================>
  static SPIClass epdSPI(FSPI);

  // <===================>
  //   E-Paper SPI pins
  // <===================>
  static constexpr int PIN_SCK  = 36;
  static constexpr int PIN_MOSI = 45;
  static constexpr int PIN_MISO = -1;

  // <===================>
  //   E-Paper SPI pins
  // <===================>
  static constexpr int PIN_CS   = 26;
  static constexpr int PIN_DC   = 48;
  static constexpr int PIN_RST  = 47;
  static constexpr int PIN_BUSY = 34;

  // <===================>
  //   3.7'' EPD Module
  // <===================>
  static GxEPD2_BW<GxEPD2_370_GDEY037T03, GxEPD2_370_GDEY037T03::HEIGHT> display(GxEPD2_370_GDEY037T03(PIN_CS, PIN_DC, PIN_RST, PIN_BUSY));

  // <===================>
  //   Message Variables
  // <===================>
  constexpr int MAX_LINES = 5;
  Message screenLines[MAX_LINES];

  void init()
  {
    display.init(115200, true, 50, false);

    pinMode(PIN_BUSY, INPUT);
    pinMode(PIN_RST, OUTPUT);
    
    epdSPI.begin(PIN_SCK, PIN_MISO, PIN_MOSI, PIN_CS);

    // Bind SPI to display (recommended on ESP32-S3)
    display.epd2.selectSPI(
      epdSPI,
      SPISettings(4000000, MSBFIRST, SPI_MODE0)
    );
    
    display.setRotation(1);
  }

  static void drawMessageInputBuffer()
  {
    constexpr int TB_X = 18;
    constexpr int TB_Y = 196;
    constexpr int TB_W = 380;
    constexpr int TB_H = 26;

    display.fillRect(TB_X, TB_Y, TB_W, TB_H, GxEPD_WHITE);
    display.drawRect(TB_X, TB_Y, TB_W, TB_H, GxEPD_BLACK);
  }

  void updateMessageInputBuffer(const char* keyBuffer)
  {
    constexpr int TB_X = 18;
    constexpr int TB_Y = 196;
    constexpr int TB_W = 380;
    constexpr int TB_H = 26;

    display.setFont(&FreeSans9pt7b);
    display.setPartialWindow(TB_X, TB_Y, TB_W, TB_H);
    display.firstPage();
    do
    {
      display.fillRect(TB_X, TB_Y, TB_W, TB_H, GxEPD_WHITE);
      display.drawRect(TB_X, TB_Y, TB_W, TB_H, GxEPD_BLACK);
      display.setCursor(TB_X + 5, TB_Y + 18);
      display.print(keyBuffer);
    }
    while (display.nextPage());

    // !!!!!!!!!!!!!!!!!!!!!!!!!!!!!!!!!!!!!ADD BLINK CURSOR EVENTUALLY!!!!!!!!!!!!!!!!!!!!!!!!!!!!!!!!!!!!!!!!!!!!!!!!!!!!!!!!
  }

  static void drawConfigInputBuffer()
  {
    constexpr int TB_X = 104;
    constexpr int TB_Y = 140;
    constexpr int TB_W = 184;
    constexpr int TB_H = 26;

    // ADD UNDERLINES FOR EACH CHAR

    display.fillRect(TB_X, TB_Y, TB_W, TB_H, GxEPD_WHITE);
    display.drawRect(TB_X, TB_Y, TB_W, TB_H, GxEPD_BLACK);
  }

  void updateConfigInputBuffer(const char* keyBuffer)
  { 
    constexpr int TB_X = 104;
    constexpr int TB_Y = 140;
    constexpr int TB_W = 184;
    constexpr int TB_H = 26;

    display.setFont(&FreeSans9pt7b);
    display.setPartialWindow(TB_X, TB_Y, TB_W, TB_H);
    display.firstPage();
    do
    {
      display.fillRect(TB_X, TB_Y, TB_W, TB_H, GxEPD_WHITE);
      display.drawRect(TB_X, TB_Y, TB_W, TB_H, GxEPD_BLACK);
      display.setCursor(TB_X + 5, TB_Y + 18);
      display.print(keyBuffer);
    }
    while (display.nextPage());
  }

  static void drawDeviceState(char* stateName)
  {
    constexpr int STATE_X = 12;
    constexpr int STATE_Y = 12;
    constexpr int STATE_H = 26;

    constexpr int TEXT_MARGIN = 5;
    constexpr int LINE_HEIGHT = 18;
    
    // char* stateName = "";

    // switch(state)
    // {
    //   case STATE_CONFIG:
    //     stateName = "Config";
    //     break;
    //   case STATE_PAIRING:
    //     stateName = "Pairing";
    //     break;
    //   case STATE_CONNECTED:
    //     stateName = "Connected";
    //     break;
    // }

    int16_t x1, y1;
    uint16_t w, h;

    display.getTextBounds(stateName, STATE_X, STATE_Y, &x1, &y1, &w, &h);

    display.drawRect(STATE_X, STATE_Y, w + (TEXT_MARGIN * 2), STATE_H, GxEPD_BLACK);
    display.setCursor(STATE_X + TEXT_MARGIN, STATE_Y + LINE_HEIGHT);
    display.print(stateName);
  }

  static void drawActiveScreen(char* stateName) 
  {
    // 416x240
    display.setFont(&FreeSansBold9pt7b);
    display.setTextColor(GxEPD_BLACK);

    // MOVE ALL THESE CONSTS TO HEADER
    constexpr int OUTLINE_X = 6;
    constexpr int OUTLINE_Y = 6;
    constexpr int OUTLINE_W = 404;
    constexpr int OUTLINE_H = 228;

    constexpr int INNER_BOX_X = 12;
    constexpr int INNER_BOX_Y = 44;
    constexpr int INNER_BOX_W = 392;
    constexpr int INNER_BOX_H = 184;


    display.fillScreen(GxEPD_WHITE);
    display.drawRect(OUTLINE_X, OUTLINE_Y, OUTLINE_W, OUTLINE_H, GxEPD_BLACK);
    drawDeviceState(stateName);
    display.drawRect(INNER_BOX_X, INNER_BOX_Y, INNER_BOX_W, INNER_BOX_H, GxEPD_BLACK);
  }

  void drawConnectedScreen()
  {
    display.setFullWindow();
    display.firstPage();
    do
    {
      drawActiveScreen("Connected");
      drawMessageInputBuffer();
    }
    while (display.nextPage());
  }

  void drawPairingScreen()
  {
    constexpr unsigned int Y = 112;

    int16_t x1, y1;
    uint16_t w, h;

    char* title = "Waiting for peer to connect...";

    display.setFont(&FreeSansBold9pt7b);
    display.setFullWindow();
    display.firstPage();
    do
    {
      display.getTextBounds(title, 0, Y, &x1, &y1, &w, &h);

      int x = (SCREEN_WIDTH - w) / 2 - x1;

      drawActiveScreen("Pairing");

      display.setCursor(x, Y);
      display.print(title);
    }
    while (display.nextPage());
  }

  void drawConfigScreen()
  {
    constexpr unsigned int Y = 112;

    int16_t x1, y1;
    uint16_t w, h;

    char* title = "Enter 12 character passphrase";

    display.setFont(&FreeSansBold9pt7b);
    display.setFullWindow();
    display.firstPage();
    do
    {
      display.getTextBounds(title, 0, Y, &x1, &y1, &w, &h);

      int x = (SCREEN_WIDTH - w) / 2 - x1;

      drawActiveScreen("Config");

      display.setCursor(x, Y);
      display.print(title);

      drawConfigInputBuffer();
    }
    while (display.nextPage());
  }

  void drawSleepingScreen()
  {
    constexpr int OUTLINE_X = 6;
    constexpr int OUTLINE_Y = 6;
    constexpr int OUTLINE_W = 404;
    constexpr int OUTLINE_H = 228;

    display.setFullWindow();
    display.firstPage();
    do
    {
      display.fillScreen(GxEPD_WHITE);
      display.drawRect(OUTLINE_X, OUTLINE_Y, OUTLINE_W, OUTLINE_H, GxEPD_BLACK);
      display.drawXBitmap(108, 20, logoBitmapData, 200, 200, GxEPD_BLACK);
    }
    while (display.nextPage());
  }

  void updateBattery(int percentage, bool charging)
  {
    constexpr int BAT_X = 344;
    constexpr int BAT_Y = 12;
    constexpr int BAT_W = 60;
    constexpr int BAT_H = 26;

    constexpr int TEXT_MARGIN = 5;
    constexpr int LINE_HEIGHT = 18;

    display.setFont(&FreeSansBold9pt7b);
    display.setPartialWindow(BAT_X, BAT_Y, BAT_W, BAT_H);
    display.firstPage();
    do
    {
      display.fillRect(BAT_X, BAT_Y, BAT_W, BAT_H, GxEPD_WHITE);
      display.drawRect(BAT_X, BAT_Y, BAT_W, BAT_H, GxEPD_BLACK);

      display.setCursor(BAT_X + TEXT_MARGIN, BAT_Y + LINE_HEIGHT);
      if (charging)
      {
        display.print("CHRG");
      } 
      else
      {
        display.print(percentage);
        display.print("%");
      }
    }
    while (display.nextPage());
  }

  void updateTimer(int elapsed) 
  {
    // constexpr unsigned int LINE_HEIGHT = 18;
    constexpr unsigned int MARGIN      = 2;
    constexpr unsigned int Y           = 160;

    char buffer[32];

    unsigned int seconds = elapsed % 60;
    unsigned int minutes = elapsed / 60;

    sprintf(buffer, "%02d:%02d", minutes, seconds);

    int16_t x1, y1;
    uint16_t w, h;

    display.getTextBounds(buffer, 0, Y, &x1, &y1, &w, &h);

    int x = (SCREEN_WIDTH - w) / 2 - x1;

    display.setFont(&FreeSans9pt7b);
    display.setPartialWindow(x, Y - h - MARGIN, w + (MARGIN * 2), h + (MARGIN * 2));
    display.firstPage();
    do
    { 
      display.setCursor(x, Y);
      display.print(buffer);
    }
    while (display.nextPage());
  }

  void addMessage(const Message& msg)
  {
    // shift lines up
    for (int i = 0; i < MAX_LINES - 1; i++)
    {
      screenLines[i] = screenLines[i + 1];
    }

    // newest at bottom
    screenLines[MAX_LINES - 1] = msg;
  }

  void clearMessageLines()
  {
    for (int i = 0; i < MAX_LINES; i++)
    {
        screenLines[i].text[0] = '\0';
        screenLines[i].outgoing = false;
    }
  }

  void drawMessage(Message& msg, int y)
  {
    constexpr int MARGIN = 4;
    constexpr int LINE_HEIGHT = 18;
    constexpr int RIGHT_BOUND = 402;

    int LEFT_BOUND = 20;

    int16_t x1, y1;
    uint16_t w, h;

    display.getTextBounds(msg.text, LEFT_BOUND, y, &x1, &y1, &w, &h);

    if (msg.outgoing)
    {
      LEFT_BOUND = RIGHT_BOUND - (w + (MARGIN * 2));
    }

    display.drawRect(LEFT_BOUND - MARGIN, y - LINE_HEIGHT, w + (MARGIN * 2), LINE_HEIGHT + (MARGIN * 2), GxEPD_BLACK);
    display.setCursor(LEFT_BOUND, y);
    display.print(msg.text);

    Serial.println(msg.text);
  }


  // EVENTUALLY REWRITE SO IT DOESNT REQUIRE FULL REDRAW OF REGION
  void drawMessages()
  {
    constexpr int INNER_BOX_X = 14;
    constexpr int INNER_BOX_Y = 48;
    constexpr int INNER_BOX_W = 388;
    constexpr int INNER_BOX_H = 152;

    display.setFont(&FreeSans9pt7b);
    display.setPartialWindow(INNER_BOX_X, INNER_BOX_Y, INNER_BOX_W, INNER_BOX_H);
    display.firstPage();
    do
    {
      constexpr int LINE_HEIGHT = 20; //display.getTextBounds("Hello", 0, 0, &x1, &y1, &w, &h);
      constexpr int MARGIN = 8;
      int cnt = 0;
      for (int i = 0; i < MAX_LINES; i++)
      {
        if (screenLines[i].text[0] != '\0')
        {

          int y = (INNER_BOX_Y + LINE_HEIGHT) + (cnt * (LINE_HEIGHT + MARGIN));

          drawMessage(screenLines[i], y);
          cnt++;
        }
      }
    }
    while (display.nextPage());
  }
}
